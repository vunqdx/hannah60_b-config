## boards/arm/hannah60/Kconfig.board
```kconfig
# Zaphod board configuration

# Copyright (c) 2020 Pete Johanson
# SPDX-License-Identifier: MIT

config BOARD_HANNAH60
	bool "Hannah60"
	depends on SOC_NRF52840_QIAA
```
